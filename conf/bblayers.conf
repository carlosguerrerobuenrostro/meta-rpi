## conf/bblayers.conf
```bitbake
# POKY_BBLAYERS_CONF_VERSION is increased each time build/conf/bblayers.conf
# changes incompatibly
POKY_BBLAYERS_CONF_VERSION = "2"

BBPATH = "${TOPDIR}"
BBFILES ?= ""

BBLAYERS ?= " \
    ${HOME}/yocto/poky-thud/meta \
    ${HOME}/yocto/poky-thud/meta-poky \
    ${HOME}/yocto/poky-thud/meta-openembedded/meta-oe \
    ${HOME}/yocto/poky-thud/meta-openembedded/meta-multimedia \
    ${HOME}/yocto/poky-thud/meta-openembedded/meta-networking \
    ${HOME}/yocto/poky-thud/meta-openembedded/meta-perl \
    ${HOME}/yocto/poky-thud/meta-openembedded/meta-python \
    ${HOME}/yocto/poky-thud/meta-openembedded/meta-webserver \
    ${HOME}/yocto/poky-thud/meta-qt5 \
    ${HOME}/yocto/poky-thud/meta-raspberrypi \
    ${HOME}/yocto/rpi/meta-rpi \
"
```
